/**
 * @cliArgs --device "AWR294X" --package "ETS" --part "Default" --context "c66ss0" --product "MCU_PLUS_SDK_AWR2944@09.02.00"
 * @versions {"tool":"1.20.0+3587"}
 */

/**
 * Import the modules used in this configuration.
 */
const crc       = scripting.addModule("/drivers/crc/crc", {}, false);
const crc1      = crc.addInstance();
const edma      = scripting.addModule("/drivers/edma/edma", {}, false);
const edma1     = edma.addInstance();
const hwa       = scripting.addModule("/drivers/hwa/hwa", {}, false);
const hwa1      = hwa.addInstance();
const ipc       = scripting.addModule("/drivers/ipc/ipc");
const cache_c6x = scripting.addModule("/kernel/dpl/cache_c6x");
const clock     = scripting.addModule("/kernel/dpl/clock");
const debug_log = scripting.addModule("/kernel/dpl/debug_log");

/**
 * Write custom configuration values to the imported modules.
 */
crc1.$name = "CONFIG_CRC0";

edma1.$name                        = "CONFIG_EDMA0";
edma1.instance                     = "EDMA_DSS_A";
edma1.edmaRmDmaCh[0].$name         = "CONFIG_EDMA_RM0";
edma1.edmaRmDmaCh[0].resourceType  = scripting.forceWrite("ownDmaCh");
edma1.edmaRmDmaCh[0].endIndex      = 63;
edma1.edmaRmQdmaCh[0].$name        = "CONFIG_EDMA_RM1";
edma1.edmaRmTcc[0].$name           = "CONFIG_EDMA_RM2";
edma1.edmaRmTcc[0].endIndex        = 63;
edma1.edmaRmParam[0].$name         = "CONFIG_EDMA_RM3";
edma1.edmaRmParam[0].endIndex      = 127;
edma1.edmaRmReservedDmaCh[0].$name = "CONFIG_EDMA_RM4";

hwa1.$name = "CONFIG_HWA0";

ipc.vringNumBuf  = 1;
ipc.vringMsgSize = 1152;
ipc.r5fss0_1     = "NONE";

cache_c6x.marRegionConfig.create(2);
cache_c6x.marRegionConfig[0].$name          = "kernel_dpl_cache_c6x_mar0";
cache_c6x.marRegionConfig[0].baseAddr       = 0xC5000000;
cache_c6x.marRegionConfig[1].$name          = "kernel_dpl_cache_c6x_mar1";
cache_c6x.marRegionConfig[1].baseAddr       = 0x88000000;
cache_c6x.marRegionConfig[1].enablePrefetch = true;

debug_log.enableCssLog = false;
